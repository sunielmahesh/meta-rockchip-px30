## conf/distro/include/rockchip-distro-base.inc
```bitbake
require conf/distro/poky.conf

DISTRO = "rockchip-distro-base"
DISTRO_NAME = "Rockchip Distro Base"
SDK_VENDOR = "-rockchipsdk"

# xserver
XSERVER = " \
	xserver-xorg \
	xserver-xorg-utils \
	xserver-xorg-xvfb \
	xserver-xorg-extension-glx \
	xserver-xorg-module-libwfb \
	xserver-xorg-module-exa \
	xf86-video-modesetting \
	xf86-input-evdev \
	xf86-input-mouse \
	xf86-input-keyboard \
	"

DISTRO_FEATURES += " \
    alsa \
    usbgadget \
    usbhost \
    bluez5 \
    x11 \
    opengl \
    systemd \
    "
```

## conf/distro/rockchip-distro-x11.conf
```bitbake
require conf/distro/include/rockchip-distro-base.inc

DISTRO = "rockchip-distro-x11"
DISTRO_NAME = "Rockchip X11"
```

## conf/layer.conf
```bitbake
# Custom meta layer configuration

# Set path
BBPATH .= ":${LAYERDIR}"

# Add recipes
BBFILES += "${LAYERDIR}/recipes-*/*/*.bb ${LAYERDIR}/recipes-*/*/*.bbappend"

BBFILE_COLLECTIONS += "meta-rockchip"
BBFILE_PATTERN_meta-rockchip = "^${LAYERDIR}/"
BBFILE_PRIORITY_meta-rockchip = "6"

LAYERDEPENDS_meta-rockchip = "core"
LAYERSERIES_COMPAT_meta-rockchip = "master honister"
```

## conf/machine/include/px30.inc
```bitbake
# Copyright (c) 2021, Amarula India Pvt Ltd
# Released under the MIT license (see COPYING.MIT for the terms)

SOC_FAMILY ?= "px30"

DEFAULTTUNE ?= "cortexa35-crypto"

require conf/machine/include/soc-family.inc
require conf/machine/include/tune-cortexa35.inc
require conf/machine/include/rockchip-wic.inc

KBUILD_DEFCONFIG ?= "defconfig"
KERNEL_CLASSES = "kernel-fitimage"
KERNEL_IMAGETYPE = "fitImage"

TFA_PLATFORM = "px30"
TFA_BUILD_TARGET = "bl31"

UBOOT_SUFFIX ?= "itb"
UBOOT_ENTRYPOINT ?= "0x280000"

SERIAL_CONSOLES = "115200;ttyS2"
```

## conf/machine/rockchip-px30-ctouch-20.conf
```bitbake
#@TYPE: Machine
#@NAME: rockchip-px30-ctouch-20
#@DESCRIPTION: Machine configuration for the engicam ctouch2.0, base on Rockchip PX30 CPU

require conf/machine/include/px30.inc

KERNEL_DEVICETREE = "rockchip/px30-engicam-px30-core-ctouch2.dtb"
UBOOT_MACHINE = "px30-core-ctouch2-px30_defconfig"
```
